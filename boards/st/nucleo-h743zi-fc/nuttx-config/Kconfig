## src/modules/board_status_leds/Kconfig
```kconfig
menuconfig MODULES_BOARD_STATUS_LEDS
	bool "board_status_leds"
	default y
	---help---
		Enable board status LEDs module (IMU/Mag/Fusion indication)
```

## src/modules/sensor_stub/Kconfig
```kconfig
menuconfig MODULES_SENSOR_STUB
	bool "sensor_stub"
	default y
	---help---
		Enable sensor_stub module (publish sensor_accel[0/1] & sensor_mag for bringup)
```
